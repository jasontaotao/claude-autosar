AUTOSAR XML (schema 4-2-2)
package /TestPackage
  module config Can
    CanConfigSet
      CanTxIPdu_0 (CanTxIPdu): CanTxIPduHandleId=101, CanTxIPduLength=8
      CanTxIPdu_1 (CanTxIPdu): CanTxIPduHandleId=102, CanTxIPduLength=16
      CanRxIPdu_0 (CanRxIPdu): CanRxIPduHandleId=200, CanRxIPduLength=4
