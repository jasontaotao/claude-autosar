AUTOSAR XML (schema 4-2-2)
package /TestPackage
  module config Can
    CanConfigSet
      CanTxIPdu_0 (CanTxIPdu): CanTxIPduHandleId=100, CanTxIPduLength=8
      CanRxIPdu_0 (CanRxIPdu): CanRxIPduHandleId=200, CanRxIPduLength=4
