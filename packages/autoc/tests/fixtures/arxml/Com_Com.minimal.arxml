AUTOSAR XML (schema 4-2-2)
package /TestPackage
  module config Com
    ComGeneral: ComConfigurationUsage=0, ComSupportedIPduGroups=2
    ComConfigSet
      CanConfigSet_Tx_Test1 (ComConfigSet)
        ComTxIPdu: ComTxIPduHandleId=100, ComTxIPduLength=8, ComTxIPduCanId=256, ComTxIPduDirection=CAN
          ComSignal: ComBitPosition=0, ComBitSize=16, ComSignalByteOrder=LITTLE_ENDIAN, ComSignalInitValue=0
          ComSignal: ComBitPosition=16, ComBitSize=8, ComSignalByteOrder=LITTLE_ENDIAN
        ComRxIPdu: ComRxIPduHandleId=200, ComRxIPduLength=4, ComRxIPduCanId=512
          ComSignal: ComBitPosition=0, ComBitSize=32, ComSignalByteOrder=BIG_ENDIAN, ComSignalInitValue=1
